#include "OLED.h"
#include <string.h>
#include <stdio.h> // Necesario para sprintf

static sOLEDHandle oled;
static uint8_t bufferRAM[1024];
static eOLEDStatus oled_status = OLED_IDLE;
static uint8_t pagina_actual = 0;
static uint8_t sub_estado = 0; // ¡CORRECCIÓN! Ahora es global para que el Callback la vea

// Comandos de inicialización para SH1106
static const uint8_t init_cmds[] = {
    0xAE, 0x20, 0x02, 0x81, 0x80, 0xA1, 0xC8, 0xAF
};

// Fuente ASCII 5x7 básica (Desde el espacio ' ' hasta el '~')
// Ocupa solo 475 bytes de memoria Flash
static const uint8_t font5x7[] = {
    0x00, 0x00, 0x00, 0x00, 0x00, // Space
    0x00, 0x00, 0x5f, 0x00, 0x00, // !
    0x00, 0x07, 0x00, 0x07, 0x00, // "
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    0x10, 0x08, 0x10, 0x08, 0x10  // ~
};

// ---------------------------------------------------------
// FUNCIONES CORE DE INICIO Y ACTUALIZACIÓN
// ---------------------------------------------------------

void OLED_Init(sOLEDHandle *hOLED) {
    oled = *hOLED;
    for (int i = 0; i < sizeof(init_cmds); i++) {
        oled.I2C_WriteCmd(init_cmds[i]);
    }
    OLED_Clear();

    // --- LÍNEA DE PRUEBA DE FUEGO ---
        // Dibujamos un texto gigante en la memoria antes de mandar el Update
        OLED_Print(10, 20, "TEST OK", 2, 1);
    OLED_Update();
}

void OLED_Update(void) {
    if (oled_status == OLED_IDLE) {
        oled_status = OLED_BUSY;
        pagina_actual = 0;
        sub_estado = 0; // Nos aseguramos de arrancar limpios
    }
}

void OLED_Task(void) {
    // Si no hay nada que actualizar, salimos
    if (oled_status != OLED_BUSY) return;

    // Si ya mandamos las 8 páginas (0 a 7), terminamos el cuadro
    if (pagina_actual > 7) {
        oled_status = OLED_IDLE;
        return;
    }

    if (sub_estado == 0) {
        oled.I2C_WriteCmd(0xB0 + pagina_actual);
        oled.I2C_WriteCmd(0x02); // Dejamos el offset de 0x02 por si es de 1.3"
        oled.I2C_WriteCmd(0x10);
        sub_estado = 1;
    }
    else if (sub_estado == 1) {
        uint8_t *ptr_datos = &bufferRAM[pagina_actual * 128];
        oled.I2C_WriteData_DMA(ptr_datos, 128);
        sub_estado = 2; // El microcontrolador se queda esperando en estado 2
    }
}

void OLED_DMA_Callback(void) {
    if (oled_status == OLED_BUSY) {
        pagina_actual++; // Avanzamos a la fila de abajo
        sub_estado = 0;  // ¡LA MAGIA! Volvemos a cero para destrabar la Task
    }
}

// ---------------------------------------------------------
// FUNCIONES DE DIBUJO EN RAM
// ---------------------------------------------------------

void OLED_Clear(void) {
    memset(bufferRAM, 0x00, sizeof(bufferRAM));
}

void OLED_DrawPixel(uint8_t x, uint8_t y, uint8_t color) {
    if (x >= 128 || y >= 64) return;
    uint16_t indice = x + ((y / 8) * 128);

    if (color) {
        bufferRAM[indice] |= (1 << (y % 8));
    } else {
        bufferRAM[indice] &= ~(1 << (y % 8));
    }
}

void OLED_DrawHLine(uint8_t x, uint8_t y, uint8_t length, uint8_t color) {
    for (uint8_t i = 0; i < length; i++) {
        OLED_DrawPixel(x + i, y, color);
    }
}
void OLED_DrawVLine(uint8_t x, uint8_t y, uint8_t length, uint8_t color) {
    for (uint8_t i = 0; i < length; i++) {
        OLED_DrawPixel(x, y + i, color);
    }
}

void OLED_DrawRect(uint8_t x, uint8_t y, uint8_t w, uint8_t h, uint8_t color) {
    OLED_DrawHLine(x, y, w, color);
    OLED_DrawHLine(x, y + h - 1, w, color);
    OLED_DrawVLine(x, y, h, color);
    OLED_DrawVLine(x + w - 1, y, h, color);
}

void OLED_FillRect(uint8_t x, uint8_t y, uint8_t w, uint8_t h, uint8_t color) {
    for (uint8_t i = 0; i < h; i++) {
        OLED_DrawHLine(x, y + i, w, color);
    }
}

void OLED_DrawCircle(int32_t x0, int32_t y0, int32_t radius, uint8_t color) {
    int32_t x = radius;
    int32_t y = 0;
    int32_t err = 0;

    while (x >= y) {
        // Aprovechamos la simetría de 8 octantes del círculo
        OLED_DrawPixel(x0 + x, y0 + y, color);
        OLED_DrawPixel(x0 + y, y0 + x, color);
        OLED_DrawPixel(x0 - y, y0 + x, color);
        OLED_DrawPixel(x0 - x, y0 + y, color);
        OLED_DrawPixel(x0 - x, y0 - y, color);
        OLED_DrawPixel(x0 - y, y0 - x, color);
        OLED_DrawPixel(x0 + y, y0 - x, color);
        OLED_DrawPixel(x0 + x, y0 - y, color);

        if (err <= 0) {
            y += 1;
            err += 2 * y + 1;
        }

        if (err > 0) {
            x -= 1;
            err -= 2 * x + 1;
        }
    }
}

void OLED_PutChar(uint8_t x, uint8_t y, char c, uint8_t size, uint8_t color) {
    if (c < 32 || c > 126) return;

    for (uint8_t i = 0; i < 5; i++) {
        uint8_t linea_bits = font5x7[(c - 32) * 5 + i];

        for (uint8_t j = 0; j < 8; j++) {
            if (linea_bits & (1 << j)) {
                if (size == 1) {
                    OLED_DrawPixel(x + i, y + j, color);
                } else {
                    for (uint8_t sx = 0; sx < size; sx++) {
                        for (uint8_t sy = 0; sy < size; sy++) {
                            OLED_DrawPixel(x + (i * size) + sx, y + (j * size) + sy, color);
                        }
                    }
                }
            }
        }
    }
}

void OLED_Print(uint8_t x, uint8_t y, const char* str, uint8_t size, uint8_t color) {
    uint8_t cursor_x = x;
    while (*str) {
        OLED_PutChar(cursor_x, y, *str, size, color);
        cursor_x += (5 * size) + 1;
        str++;
    }
}

// ---------------------------------------------------------
// CONSTRUCTOR ESPECÍFICO DE PANTALLA
// ---------------------------------------------------------

void OLED_ShowTelemetry(uint16_t ir_izq, uint16_t ir_cen, uint16_t ir_der) {
    char buf[30];

    // 1. Limpiamos el buffer local
    OLED_Clear();

    // 2. Encabezado en tamaño 2 con subrayado
    OLED_Print(0, 0, "TELEMETRIA", 2, 1);
    OLED_DrawHLine(0, 16, 128, 1);

    // 3. Imprimimos los valores formateados
    sprintf(buf, "IR Izq: %4u", ir_izq);
    OLED_Print(0, 22, buf, 1, 1);

    sprintf(buf, "IR Cen: %4u", ir_cen);
    OLED_Print(0, 34, buf, 1, 1);

    sprintf(buf, "IR Der: %4u", ir_der);
    OLED_Print(0, 46, buf, 1, 1);

    // 4. Marcamos el buffer como listo para ser enviado por la Task
    OLED_Update();
}
